## conf/layer.conf
```bitbake
# We have a conf and classes directory, add to BBPATH
BBPATH .= ":${LAYERDIR}"

# We have recipes-* directories, add to BBFILES
BBFILES += "${LAYERDIR}/recipes-*/*/*.bb ${LAYERDIR}/recipes-*/*/*.bbappend"

BBFILE_COLLECTIONS += "hyprland_de"
BBFILE_PATTERN_hyprland_de = "^${LAYERDIR}/"
BBFILE_PRIORITY_hyprland_de = "8"

LAYERSERIES_COMPAT_hyprland_de = "nanbield"

LAYERDEPENDS_hyprland_de = " \
	core \
	openembedded-layer \
"
```
